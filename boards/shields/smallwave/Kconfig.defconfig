## boards/shields/smallwave/Kconfig.defconfig
```kconfig
# Copyright (c) 2022 Duccio Breschi
# SPDX-License-Identifier: MIT

if SHIELD_SMALLWAVE_LEFT

config ZMK_KEYBOARD_NAME
    default "smallwave"

config ZMK_SPLIT_ROLE_CENTRAL
    default y

endif

if SHIELD_SMALLWAVE_LEFT || SHIELD_SMALLWAVE_RIGHT
config ZMK_SPLIT
    default y
endif
```

## boards/shields/smallwave/Kconfig.shield
```kconfig
# Copyright (c) 2022 Duccio Breschi
# SPDX-License-Identifier: MIT

config SHIELD_SMALLWAVE_LEFT
    def_bool $(shields_list_contains,smallwave_left)

config SHIELD_SMALLWAVE_RIGHT
    def_bool $(shields_list_contains,smallwave_right)
```
