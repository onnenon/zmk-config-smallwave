## config/west.yml
```yaml
manifest:
  remotes:
    - name: zmkfirmware
      url-base: https://github.com/zmkfirmware
    - name: onnenon
      url-base: https://github.com/onnenon
  projects:
    - name: zmk
      remote: zmkfirmware
      revision: v0.3
      import: app/west.yml
    - name: zmk-config-smallwave
      remote: onnenon
      revision: main
  self:
    path: config
```
